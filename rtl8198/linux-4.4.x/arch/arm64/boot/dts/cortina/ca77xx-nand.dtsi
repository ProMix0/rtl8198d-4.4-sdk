/*
 * ca77xx-nand.dtsi - Device Tree Include file for CA77xx SoC with
 * Nand flash controller.
 *
 * Copyright (C) 2016 Cortina-Access <jason.li@cortina-access.com>
 *
 */

/ {
	nflash@f4324000 {
		#address-cells = <2>;
		#size-cells = <2>;
		compatible = "cortina,nflash";
		reg =   <0x00000000 0xf4324000 0x0 0x3a8>,		/* Flash controller */
				<0x00000000 0xE0000000 0x0 0x10000000>,	/* Flash memory base */
				<0x00000000 0xf7001000 0x0 0xb0>,		/* DMA global register */
				<0x00000000 0xf7001a00 0x0 0x80>;		/* DMA controll base */

		nand-ecc-alg = <3>;	/* 0: Hamming 256 3B*/
							/* 1: Hamming 512 3B*/
							/* 2: BCH 8 */
							/* 3: BCH 16 */
							/* 4: BCH 24 */
							/* 5: BCH 40 */
		nand-ecc-step-size = <1024>; /* number of data bytes
										that are covered by a single ECC step*/


		partition@0000000001b00000{
			label = "rootfs";
			reg = <0x0 0x1b00000 0x0 0xD000000>;
			//  reg = <0x0 0x3900000 0x0 0xC700000>;
		};

/*
		partition@0000000001000000 {
			label = "kernel";
			reg = <0x0 0x1000000 0x0 0x01000000>;
		};
		partition@000000002000000 {
			label = "user";
			reg = <0x0 0x2000000 0x0 0x06000000>;
		};
*/
	};
 };
