## rtl8198/linux-4.4.x/drivers/ptool/Kconfig
```kconfig
#
# Realtek Performance Monitor Drivers
#

config RTK_PTOOL
	bool "Realtek performance tools"
	default n
	help
	  Say y if you want to use Realtek performance monitors tools.

config RTK_PTOOL_CPU_PERF
	depends on RTK_PTOOL
	bool "Realtek CPU performance tool"
	default n
	help
	  Say y if you want to use Realtek CPU performance monitor.

config RTK_PTOOL_LA_BY_GPIO
	depends on RTK_PTOOL
	bool "Realtek Logical Analysis by GPIO"
	default n
	help
	  Say y if you want to use Realtek LA by GPIO.
```

## rtl8198/linux-4.4.x/drivers/reset/Kconfig
```kconfig
config ARCH_HAS_RESET_CONTROLLER
	bool

menuconfig RESET_CONTROLLER
	bool "Reset Controller Support"
	default y if ARCH_HAS_RESET_CONTROLLER
	help
	  Generic Reset Controller support.

	  This framework is designed to abstract reset handling of devices
	  via GPIOs or SoC-internal reset controller modules.

	  If unsure, say no.

if RESET_CONTROLLER

config GPIO_RESET_CONTROLLER
	tristate "GPIO reset controller"
	help
	  Reset controller using GPIO lines

	  There are two main methods of using this controller:
	  * As a reset controller within the reset framework allowing device
	  drivers to request a hardware reset of their devices.
	  * As a standalone driver performing reset at boot or upon userspace
	  request (via sysfs)
	  The second method is suitable for devices on discoverable busses
	  (SDIO, USB)+config GPIO_RESET_CONTROLLER

endif

source "drivers/reset/sti/Kconfig"
```

## rtl8198/linux-4.4.x/drivers/thermal/cortina/Kconfig
```kconfig
config CA7774_RNG_OSC_THERMAL
	tristate "Cortina CA7774 (G3) internal ring oscillator thermal driver"
	depends on ARCH_CORTINA_G3 && THERMAL_OF && CPUFREQ_DT && COMMON_CLK_CA7774
	help
	  If you say yes here you get support for the internal 
	  ring oscillator based thermal sensor driver for the Cortina CA7774 (G3) SoC. 
	  This driver initialises, reports temperature in C and depends on CPUFREQ
	  to obtain CPU speed for thermal calculations.

config CA8271_THERMAL
	tristate "Cortina CA8271 (Saturn) thermal driver"
	depends on (ARCH_CORTINA_G3HGU || ARCH_CORTINA_SATURN_SFU || ARCH_CORTINA_SATURN_SFP_PLUS) && THERMAL_OF
	help
	    Support for the Cortina 8271(Saturn) thermal sensor driver into the Linux thermal
	    framework. Only Cortina Saturn and HGU are equiped with this sensor.

config CA8277_THERMAL
	tristate "Realtek CA8277 thermal driver"
	depends on (ARCH_REALTEK_TAURUS || ARCH_CORTINA_VENUS || ARCH_CORTINA_G3HGU) && THERMAL_OF
	help
	    Support for the thermal sensor driver into the Linux thermal
	    framework. 

config CORTINA_CPU_COOLING_HOTPLUG
	tristate "CORTINA CPU Hotplug for Thermal-Zone"
	depends on ARCH_CORTINA_G3HGU && CA8271_THERMAL
	help
	  If you say yes here you get support for CPU hot-plug. This driver register a cooling device 
	  to dynamically remove online CPU to reduce heat.
```

## rtl8198/linux-4.4.x/realtek/Kconfig
```kconfig
menu "Realtek Modules"
	
config RTK_NETLOG
    bool "NetLogger"
   	depends on SERIAL_8250=y
	default n if !ARCH_LUNA_SLAVE

config  RTK_KERNEL_OMD
    bool "Support RTK Kernel OMD Func"
	depends on YUEME

config RTK_HS_UART
    bool "Support RTK high speed UART"

config RTK_VBUS_CHAIN
    bool "USB VBus Chain"
       depends on USB && RESET_CONTROLLER
       help
        Select Y if board has VBUS controller IC

config  RTK_ARM64_WATCHPOINT_DEBUG
    bool "Provide ARM64 WATCHPONT Debug Func"
	depends on ARM64

config RTK_WLAN_EVENT_INDICATE
        bool "Wlan event indicate support"
        default n

source "realtek/framework_protector/Kconfig"

endmenu
```

## rtl8198/linux-4.4.x/realtek/framework_protector/Kconfig
```kconfig
menu "Realtek Framework Protector"

config YUEME_TMPFS_FEATURE
	bool "TMPFS FILE SIZE LIMITION"
	default n
	help
        Limit the size of single file under TMPFS directory!(tmpfs)

config YUEME_TMPFS_FILE_SIZE
	depends on YUEME_TMPFS_FEATURE
	int "TMPFS MAX FILE Size(MB)"
	default 128
	help
		Max Size of single file for YUEME.
		User can set the size by write some value into /proc/luna_yueme/tmpfs_file_size.

config YUEME_TMPFS_SIZE_FEATURE
        depends on YUEME && TMPFS
        int "TMPFS_FS MAX Size"
        default 0
        help
                FS /tmp and /var are limited at the value(MB) by mnt_tmpfs.sh on rc2.
                By default 0, the limitaion is 40% of Total System Mem.

config YUEME_APP_FORK_LIMIT_FEATURE
        depends on YUEME && CGROUP_SCHED
        bool "YUEME App Framework Fork Limit FEATURE"
        default n
        help
             Limit the fork number of appframework!

config YUEME_APP_FORK_LIMIT_NUM
        int "YUEME_APP_FORK_LIMIT_NUM"
        depends on YUEME_APP_FORK_LIMIT_FEATURE && YUEME && CGROUP_SCHED
        default 100
        help
                Appframework'app can't fork over this value.

config YUEME_APP_THREAD_LIMIT_NUM
        int "YUEME_APP_THREAD_LIMIT_NUM"
        depends on YUEME_APP_FORK_LIMIT_FEATURE
        default 300
        help
                Appframework'app can't create thread over this value.
	
config YUEME_APP_FORK_LIMIT_KILLER
        bool "YUEME Appframework Limit Killer"
        depends on YUEME_APP_FORK_LIMIT_FEATURE
        default n
        help
             Every 120(s), Kthread(appf_m) will try to kill the process
             which forked over YUEME_APP_FORK_LIMIT_NUM.

config YUEME_FS_CHECK_FEATURE
        bool "YUEME App Framework FS Write Check"
        depends on (YAFFS_FS || UBIFS_FS) && YUEME && CGROUP_SCHED
        default n
        help
             Avoid the application of AppFramework write fully the FS(YAFFS_FS) for Flash Partition.

config YUEME_FS_LIMIT_PERCENTAGE
        int "YUEME App Framework FS Write Allow Percentage"
        depends on YUEME_FS_CHECK_FEATURE
        range 0 100
        default 90
        help
             This option will inhibit the write operation into YAFFS_FS when FS_usage is higher than threshold.
             the FS is higher than CONFIG_YUEME_FS_LIMIT_PERCENTAGE%, the system does not allow this write operation.
             The system will try to kill this process.

endmenu
```

## rtl8198/linux-4.4.x/sound/soc/ca77xx/Kconfig
```kconfig
config SND_CA77XX_SOC
	tristate "SoC Audio for the Cortina Systems CA77XX chip"
	depends on ARCH_CORTINA
	help
	  Say Y or M if you want to add support for codecs attached to
	  the CA77XX PCM or I2S interface. You will also need
	  to select the audio interfaces to support below.

config SND_CA77XX_SOC_DIAG
	tristate "SoC Audio Diagnostic for the Cortina Systems CA77XX chip"
	depends on SND_CA77XX_SOC
	help
	  Say M if you want to add diagnostic for the CA77XX PCM or I2S
	  interface.
```

## rtl8198/tools/boot_verified_venus.its
```
/dts-v1/;
/ {
    description = "fitImage for RTK aarch64 kernel";
    #address-cells = <0x1>;
    images {
        kernel@0 {
            description = "Linux Kernel";
            data = /incbin/("./Image.lzma");
            type = "kernel";
            arch = "arm64";
            os = "linux";
            compression = "lzma";
            load = <0x80000>;
            entry = <0x80000>;
            hash@1 {
                algo = "sha1";
            };
            signature@1 {
                algo = "sha1,rsa2048";
                key-name-hint = "dev";
            };
        };
        fdt@0 {
              description = "Flattened Device Tree blob";
              data = /incbin/("./dtb.img");
              type = "flat_dt";
              load = <0x01000000>;
              arch = "arm64";
              compression = "none";
              hash@1 {
                algo = "sha1";
              };
                signature@1{
                    algo = "sha1,rsa2048";
                    key-name-hint = "dev";
                };
        };
    };
    configurations {
        default = "conf@1";
        conf@1 {
            description = "Boot Linux kernel with FDT blob ";
            kernel = "kernel@0";
            fdt = "fdt@0";
            hash@1 {
                algo = "sha1";
            };
			signature@1 {
				algo = "sha1,rsa2048";
				key-name-hint = "dev";
				sign-images = "fdt", "kernel";
			};
        };
    };
};
```
