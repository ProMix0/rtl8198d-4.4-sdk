## rtl8198/linux-4.4.x/drivers/clk/cortina/Kconfig
```kconfig
config COMMON_CLK_CA7774
	bool "Cortina CA7774 (G3) Clock Driver"
	depends on (ARCH_CORTINA_G3 || ARCH_CORTINA_G3HGU)
	help
	  Build the Cortina CA7774 clock driver based on the common clock framework.

config COMMON_CLK_CA8289
	bool "Cortina CA8289 (Venus) Clock Driver"
	depends on (ARCH_CORTINA_VENUS)
	help
	  Build the Cortina CA8289 clock driver based on the common clock framework.
```

## rtl8198/linux-4.4.x/drivers/net/ethernet/realtek/rtl86900/RT_API_demo/Kconfig
```kconfig
# RTL86900 SDK configuration
#

config COMMON_RT_API_DEMO
	bool "Build Common RT API sample Kernel module"
	depends on COMMON_RT_API
	default n
	help
	  Say Y if your machine has Common RT API and build a demo Kernel module.
```
