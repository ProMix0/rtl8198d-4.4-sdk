## rtl8198/ca_packages/ca-network-engine/1.0-r0/ca-network-engine-1.0/Kconfig
```kconfig
#
# For a description of the syntax of this configuration file,
# see Documentation/kbuild/kconfig-language.txt.
#
mainmenu "CA-Netowrk-Engine Module Configuration"
choice
	prompt "Choose target SoC"
	default ARCH_CORTINA_G3

config ARCH_CORTINA_G3
	bool "G3"
	---help---
	  G3, CA7742.

config ARCH_CORTINA_G3LITE
	bool "G3Lite"
	---help---
	  G3Lite, CA76xx, RTL8198F.

config ARCH_CORTINA_SATURN
	bool "Saturn SFU"
	---help---
	  Saturn SFU; includes CA8271A and CA8271S.

config ARCH_CORTINA_G3HGU
	bool "G3HGU"
	---help---
	  G3HGU, CA8279.

config ARCH_CORTINA_VENUS
	bool "Venus"
	---help---
	  Venus, CA8277B.


config ARCH_REALTEK_TAURUS
	bool "Taurus"
	help
	  Realtek RTL8277C TAURUS SoC.

endchoice


config NE_HAVE_DOT_CONFIG
	bool
	default y


config NE_SMALL_SLAB
	bool "Provide individual SLAB object for small memory allocation"
	default n
	---help---
	  This only occurs when the memory allocation is equal or smaller than 16 bytes.
	  Enable this to reduce memory usage in Cortina NE driver.

config NE_MUT
	bool "Memory Usage Tracing"
	default n
	---help---
	  It can trace the memory allocation/free.
	  The proc entry is at /proc/driver/cortina/ne/core/ne_memtrace.
	  It also create a cache for the memory allocation of 16-byte or less objects.

config NE_MUT_TRACE_MALLOC
	bool "Traces kmalloc / kzalloc / vmalloc"
	default y
	depends on NE_MUT
	---help---
	  In normal mode, there is a counter of kmalloc / kzalloc / vmalloc.
	  In advanced mode, there is not only a counter which is same as in normal mode,
	  but also the call stack of each allocated objects.

config NE_MUT_TRACE_SKB
	bool "Traces skb allocation"
	default y
	depends on NE_MUT
	---help---
	  In normal mode, there is a counter of skb (struct sk_buff).
	  In advanced mode, there is not only a counter which is same as in normal mode,
	  but also the call stack of each allocated objects.

choice
	prompt "Choose the tracing mode"
	default NE_MUT_NORMAL_MODE
	depends on NE_MUT

config NE_MUT_NORMAL_MODE
	bool "Normal Mode"
	---help---
	  Normal Mode provides counter only.

config NE_MUT_ADVANCED_MODE
	bool "Advanced Mode"
	---help---
	  Advanced Mode provides more detailed info than normal mode.
	  The info contains not only counter, but also the call stack of each memory allocation.

endchoice

config NE_VIRTUAL_NI
	bool "Virtual Network Interface"
	default n
	---help---
	  Support Virtual Network Interface (ex. eth0_0, eth0_1) in Cortina
	  NE driver.

config RTK_8198F_NE_PATCH
	bool "Realtek NE patch"
	default n
	---help---
	  Some suggestion come from Cortina. If the latest code had, remove ifdef.

config NE_PON
        bool "PON MAC"
        select NE_EXTERNAL_SERDES
        default n


config NE_KERNEL_HOOK
	bool "Provide Kernel Hook ability"
	default n
	---help---
	  Provide Kernel Hook ability.

config LUNA_G3_SERIES
	bool "RTK Venus patch"
	default n
	depends on ARCH_CORTINA_VENUS
	---help---
	  Add RTK patch in NE driver.

config LUNA_G3_HASH_FIB_ENHANCE
	bool "RTK Venus patch: Hash FIB enhance mode"
	default n
	depends on ARCH_CORTINA_VENUS
	---help---
	  Hash FIB enhance mode (256 bits).

if ARCH_CORTINA_G3
source ni-drv-gen1/Kconfig
source aal-gen1/Kconfig
source cortina-api/Kconfig
source adapt/l2fp/Kconfig
source adapt/l3cos/Kconfig
endif

if ARCH_CORTINA_G3LITE
source ni-drv-gen1/Kconfig
source aal-gen1/Kconfig
source cortina-api/Kconfig
source adapt/l2fp/Kconfig
source adapt/l3cos/Kconfig
endif

if ARCH_CORTINA_SATURN
source ni-drv-gen1/Kconfig
source aal-gen1/Kconfig
source cortina-api/Kconfig
source adapt/l2fp/Kconfig
source adapt/l3cos/Kconfig
endif

if ARCH_CORTINA_G3HGU
source ni-drv-gen1/Kconfig
source aal-gen1/Kconfig
source cortina-api/Kconfig
source adapt/l2fp/Kconfig
source adapt/l3cos/Kconfig
endif

if ARCH_REALTEK_TAURUS
source ni-drv-77c/Kconfig
source aal-77c/Kconfig
source cortina-api/Kconfig
source adapt/l2fp/Kconfig
source adapt/l3cos/Kconfig
endif

if ARCH_CORTINA_VENUS
source ni-drv-gen2/Kconfig
source aal-gen2/Kconfig
source cortina-api/Kconfig
source adapt/l2fp/Kconfig
source adapt/l3cos/Kconfig
endif
```

## rtl8198/ca_packages/ca-network-engine/1.0-r0/ca-network-engine-1.0/aal-gen2/Kconfig
```kconfig
config CA_NE_AAL_PORT_NUM_ETH
        int "Ethernet Port Number"
	---help---
         Number of Ethernet Port

config CA_NE_AAL_XFI
	bool "XFI Support"
        default n
	---help---
	  This is a AAL XFI module to support the XFI interface with ASIC.
	  When there is XFI interfaces supportted in our ASIC, the AAL XFI module should be turned on.

config CA_NE_EXTERNAL_SERDES
	bool "External SERDES Support"
        default y if CA_NE_AAL_XFI
        default n
	---help---
          This is for external serdes configuration setting.
          Because of phy, serdes configuration in each board may be different.

config CA_NE_AAL_L3_DDOS
	bool "L3 DDOS Support"
        default n
	---help---
         Support L3 distributed denial-of-service(DDoS) attack.
```

## rtl8198/ca_packages/ca-network-engine/1.0-r0/ca-network-engine-1.0/aal/Kconfig
```kconfig
config NE_AAL_PORT_NUM_ETH
        int "Ethernet Port Number"
	---help---
         Number of Ethernet Port


config NE_AAL_XFI
	bool "XFI Support"
        select NE_EXTERNAL_SERDES
        default n
	---help---
	  This is a AAL XFI module to support the XFI interface with ASIC.
	  When there is XFI interfaces supportted in our ASIC, the AAL XFI module should be turned on.

config NE_EXTERNAL_SERDES
	bool 
	---help---
          This is for external serdes configuration setting.
          Because of phy, serdes configuration in each board may be different.
```

## rtl8198/ca_packages/ca-network-engine/1.0-r0/ca-network-engine-1.0/adapt/l2fp/Kconfig
```kconfig
config NE_L2FP
	bool "L2 Fast Path management"
	default n
	---help---
	  The L2 Fast Path module is using the CPU ports as interface between
	  L2FE and 3rd Party OS Network Device Driver. This module is only
	  needed for the Soc which L2FE supports the CPU ports for L2 mac
	  learning/flooding.
```

## rtl8198/ca_packages/ca-network-engine/1.0-r0/ca-network-engine-1.0/adapt/l3cos/Kconfig
```kconfig
config NE_L3COS
	bool "L3 Class-of-Service (cos)"
	default n
	---help---
	  Set cos in HashLite according to certain egress packet fields.
	  Currently it only supports egress outer VID and/or egress 802.1p.
```

## rtl8198/ca_packages/ca-network-engine/1.0-r0/ca-network-engine-1.0/cortina-api/Kconfig
```kconfig
config NE_SW_SHAPER
	bool "Software Shaper"
	default n
	---help---
	  A Software Shaper to shape the traffic through CPU256 256 VoQs to WAN port.
	  This module only needed in Soc which supports CPU256 256 VoQs.

config NE_US_RATE_MANAGER
	bool "Up Stream Rate Manager"
	default n
	---help---
	  A up stream rate manager to manager the traffic through CPU256 256 VoQs to WAN port.
	  This module only needed in Soc which supports CPU256 256 VoQs.

config NE_TPUT_TEST
	bool "Throughput Test"
	default n
	---help---
	  Cortina UDP throughput test by offload processor.
	  This includes the APIs to enable offload processor to generate packets and return the statistic.

config NE_WELL_KNOWN_MULTICAST
        bool "well known multicast"
        default n
        ---help---
	  Support well-known multicast address flooding based on RFC4541.
	  The well-knowm multicast packet will be offloaded into PE.

config NE_L3_MCAST
        bool "Layer3 Multicast"
        default n
        ---help---
	  BJ4 by Aaron
```

## rtl8198/ca_packages/ca-network-engine/1.0-r0/ca-network-engine-1.0/ni-drv-gen2/Kconfig
```kconfig
config NE_CPU256
        bool "CPU256"
        default n
        ---help---
          If turn on this flag L3QM CPU256 will be supported. 

config NE_PHY_CALIBRATION
        bool "PHY calibration"
        default n
        ---help---
          BJ4

config NE_MANAGEMENT_MODE
        bool "NI management mode"
        default n
        ---help---
          BJ4

config NE_AUTO_TEST_MODE
        bool "NI auto test mode"
        default n
        ---help---
          It use to forward the test packet between analyte board and Auto Test Tool.
          Auto test tool need to connect on RGMII port.
          1. Remove the pseudo header from RGMII port(and src/dst port=9877),
                     then forward real data to target port.
          2. Add the pseudo header from other port0 - port4,
                     then forward data to RGMII port.

config NE_TX_LLID_MAP
        bool "NI TX do LLID map with source IP"
        default n
        ---help---
          Cortina API will provide LLID map to source IP
          in ca_ni_start_xmit() will look up the map table
          and get the llid from source IP and transmit it
          in pol_id of Header A

config NE_PTP_CLOCK
        bool "NI PTP Clock support"
        default n
        ---help---
          This driver adds support for using the Cortina SoC as a PTP
          clock. This clock is only useful if your PTP programs are
          getting hardware time stamps on the PTP Ethernet packets
          using the Linux SO_TIMESTAMPING API.

          This requires to enable Linux option CONFIG_PTP_1588_CLOCK.
```

## rtl8198/linux-4.4.x/arch/arm/mach-cortina/Kconfig
```kconfig
if ARCH_CORTINA

config ARCH_CORTINA_G3LITE
	bool "G3Lite SoC Support"
	select CPU_V7
	select ARM_GIC
	select HAVE_ARM_ARCH_TIMER
	select GENERIC_IRQ_CHIP
	help
	  This enables support for systems based on Cortina G3Lite SoCs.

config ARCH_RTL8198F
	bool "RTL8198F SoC Support"
	select CPU_V7
	select ARM_GIC
	select HAVE_ARM_ARCH_TIMER
	select GENERIC_IRQ_CHIP
	select PINCTRL
	select PINCTRL_RTL8198F
	select RTK_DEV_AP
	help
	  This enables support for systems based on RTL8198F SoCs.

config RTK_DEV_AP
	bool "Realtek Device type Wifi AP"
	help
	  This product is designed for Wifi AP.

if ARCH_RTL8198F || ARCH_CORTINA_G3LITE

choice
	prompt "Board Type"
	default CORTINA_BOARD_FPGA
	help
	  Choose the board type

config CORTINA_BOARD_FPGA
	bool "FPGA Board"
	help
	  Support for the FPGA board.

config CORTINA_BOARD_8198F_ENG
	bool "Engineering Board"
	help
	  Support for the Engineering Board

endchoice

endif

source "arch/arm/mach-cortina/Kconfig.hook"

config CORTINA_CPU_TAG
	bool "Cortina NE CPU_TAG Support"
	default n
	depends on ARCH_CORTINA_G3LITE
	depends on RTL_83XX_SUPPORT
	help
	  CPU_TAG function in Network Engine.
	  This is only supported in G3Lite SoC.

config CORTINA_SHORT_IPG
	bool
	default y
	depends on CORTINA_CPU_TAG

config RTK_PERF_EVENTS
	bool "light ARM PMU by Realtek"
	default n
	depends on ARCH_CORTINA_G3LITE
	help
	  This is only tested in G3Lite SoC.
	  
endif
```

## rtl8198/linux-4.4.x/arch/arm/mach-cortina/Kconfig.hook
```kconfig
menu "RTK 98F Selection"
config RTK_SOC
        bool "RTK SoC Drivers Support"
        default n
        help
          Build drivers/soc/realtek folder.

config OPENWRT_SDK
	bool "Openwrt support"
	default n
	help
		Openwrt build config.

config RTK_PROC_GPIO_FILES
        bool "RTK proc gpio files Support"
        depends on RTK_SOC
        default n
        help
          Build drivers/soc/realtek folder.

config WIFI_LED_USE_SOC_GPIO
        bool "Support using SoC gpio for WIFI LED"
        depends on RTK_PROC_GPIO_FILES
	default n
	help
		WIFI LED.

config WPS_LED
	bool "Support WPS LED"
	default n
	depends on RTK_PROC_GPIO_FILES
	help
		WPS LED Support.

config ONE_WPS_LED
	bool "Only one WPS LED"
	default y
	depends on WPS_LED
	help
		If target board has only one LED, must choose this config.

config RTK_RESET_WPS_SHARE_LED
	bool "WPS led shared with System led"
	depends on WPS_LED
	default n
	help
		This config used for the WPS/System share led board.

config RTK_RESET_WPS_SHARE_BUTTON
	bool "WPS pin shared with RESET button"
	depends on RTK_PROC_GPIO_FILES
	default n
	help
		This config used for the WPS/RESET share button board.

endmenu

config CORTINA_KERNEL_HOOK
	bool "G3Lite Kernel Hook Support"
	depends on ARCH_CORTINA
	select NETFILTER
	default n
	help
	  This enables kernel hook support for NI driver hardware acceleration.
	  If you would like to have NI driver hardware acceleration support, say 'Y'.

config RTK_NIC_RX_HOOK
        bool "RTK NIC RX Hook Support"
        depends on ARCH_CORTINA
        select NETFILTER
        default n
        help
          This enables kernel support for NI driver rx hook function.
          If you would like to have NI driver rx hook support, say 'Y'.

config RTK_NIC_TX_HOOK
        bool "RTK NIC TX Hook Support"
        depends on ARCH_CORTINA
        select NETFILTER
        default n
        help
          This enables kernel support for NI driver tx hook function.
          If you would like to have NI driver tx hook support, say 'Y'.

config RTL_MULTI_LAN_DEV
        bool "RTK NIC multi LAN device port mapping"
        default n
        help
          Support Virtual Network Interface Port Mapping (ex. eth0.2, eth0.3, ..., etc) in Cortina
          NE driver.
```
