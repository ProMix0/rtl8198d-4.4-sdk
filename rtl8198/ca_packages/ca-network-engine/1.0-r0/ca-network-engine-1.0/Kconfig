## rtl8198/linux-4.4.x/arch/arm64/Kconfig.hook
```kconfig
menu "RTK Luna Selection"

config BOARD_REALTEK_CA8277_PON_GPIO
        bool "Support PON GPIO Adjust"

config BOARD_REALTEK_TYPE
	bool "Use RTK Device Tree"

config SYSTEM_CAPABILITY
        prompt "System Capability"
        string
        default "0;4;2;2;1;1"
        help
                System Capability, format FE;GE;VOIP;USB;2.4G;5G

config UNI_CAPABILITY
	prompt "UNI port Capability"
	string
	help
		UNI port Capability, format is [2/1/0];[2/1/0];[2/1/0];[2/1/0];[2/1/0]
		GE port is 2, FE port is 1, None is 0
		The port number should follow CHIP spec. ex. 9607C has 5 uni ports.

config E8B
        bool "Support for CTC E8B requirement"

config YUEME
        bool "Support for CTC YueMe requirement"
        depends on E8B

config CTC_AWIFI_KERNEL_JITUAN
        bool "Jituan kernel feature"
        depends on YUEME

config CMCC
        bool "Support for CMCC requirement"
        
config CU
        bool "Support for CU requirement"
		
config CTC_SDN
        bool "Support for CTC SDN requirement"
		depends on E8B

config YUEME_DPI
        bool "Support for CTC YueMe DPI requirement"
        depends on YUEME || CU
        
config DBUS_FRAMEWORK_PATH
        prompt "Dbus Framework path"
        string
        default "/opt/upt"
        depends on YUEME || CU
		
config CU_BASEON_YUEME
	bool "CU DBUS firmware based on Yueme"
	depends on CU

config CU_BASEON_CMCC
	bool "CU OSGI firmware based on CMCC"
	depends on CU
        
choice
        prompt "Flash Size"
        default 64M_FLASH

config 4M_FLASH
        bool "4M"

config  8M_FLASH
        bool "8M"

config  16M_FLASH
        bool "16M"

config  32M_FLASH
        bool "32M"

config  48M_FLASH
        bool "48M"

config  64M_FLASH
        bool "64M"

endchoice

config FLASH_SIZE
        hex
        default "400000" if 4M_FLASH
        default "800000" if 8M_FLASH
        default "1000000" if 16M_FLASH
        default "2000000" if 32M_FLASH
        default "3000000" if 48M_FLASH
        default "4000000" if 64M_FLASH
        default "4000000"

config RTK_SOC
        bool "RTK SoC Drivers Support"
        default n
        help
          Build drivers/soc/realtek folder.

config RTK_PROC_GPIO_FILES
        bool "RTK proc gpio files Support"
        depends on RTK_SOC
        default n
        help
          Build drivers/soc/realtek folder.

choice
        prompt "LED Style"
        default GPIO_LED_TR068

config GPIO_LED_TR068
        depends on RTK_PROC_GPIO_FILES
        bool "TR068"
endchoice

config RTL8672_SW_USB_LED
        tristate "Support Software USB LED"
        depends on RTK_PROC_GPIO_FILES
        depends on USB

config SW_USB_LED0
        bool "Software USB LED 0"
        depends on RTK_PROC_GPIO_FILES
        depends on RTL8672_SW_USB_LED

config SW_USB_LED1
        bool "Software USB LED 1"
        depends on RTK_PROC_GPIO_FILES
        depends on RTL8672_SW_USB_LED


config  WPS_LED
        bool "Support WPS LED"
        default n
        depends on RTK_PROC_GPIO_FILES
        #depends on WIFI_SIMPLE_CONFIG
	help
		WPS LED Support.

config ONE_WPS_LED
        bool "Only one WPS LED"
        depends on WPS_LED

config WIFI_LED_USE_SOC_GPIO
        bool "Support using SoC gpio for WIFI LED"
        depends on RTK_PROC_GPIO_FILES
	default n
	help 
		WIFI LED.

config PUSHBUTTON_USE_EVENT_HANDLE
	bool "Support using push button by event handler"
	select GPIOLIB
	select GPIO_SYSFS
	select INPUT
	select INPUT_POLLDEV
	select INPUT_EVDEV
	select INPUT_KEYBOARD
	select KEYBOARD_GPIO

endmenu

config RTK_USE_CA_IROS
	bool "CA_IROS and CA_IROS_SCRIPTS support"
	depends on ARCH_CORTINA
	default n
	help
	  This enables Cortina CA-IROS related packages(ca_user).

config RTK_CA_PACKAGES_SKIP
	bool "Not use CA_NE, CA_PLAT, CA_SCFG...."
	depends on ARCH_CORTINA
	default n
	help
	  This options will skip CA NetworkEngine, Plat and SCFG Kernel modules.

config CORTINA_KERNEL_HOOK
	bool "G3 Kernel Hook Support"
	depends on ARCH_CORTINA
	select NETFILTER
	default n
	help
	  This enables kernel hook support for NI driver hardware acceleration.
	  If you would like to have NI driver hardware acceleration support, say 'Y'.

config RTK_NIC_RX_HOOK
        bool "RTK NIC RX Hook Support"
        depends on ARCH_CORTINA
        select NETFILTER
        default n
        help
          This enables kernel support for NI driver rx hook function.
          If you would like to have NI driver rx hook support, say 'Y'.

config RTK_NIC_TX_HOOK
        bool "RTK NIC TX Hook Support"
        depends on ARCH_CORTINA
        select NETFILTER
        default n
        help
          This enables kernel support for NI driver tx hook function.
          If you would like to have NI driver tx hook support, say 'Y'.

config RTL_MULTI_LAN_DEV
        bool "RTK NIC multi LAN device port mapping"
        default n
        help
          Support Virtual Network Interface Port Mapping (ex. eth0.2, eth0.3, ..., etc) in Cortina
          NE driver.

config RTK_CA_NE_SKB_LIMIT
        bool "RTK SKB Alloc Limitation"
	depends on LUNA_G3_SERIES
        default y if (LUNA_G3_SERIES)
        help
	  When MemAvailable < default_value(8MB), not allow ca-network-engine to alloc skb.

config RTK_WNIC_HWLOOKUP_DEAMSDU_OFFLOAD
	bool "RTK WNIC HWLOOKUP deamsdu offload"
	default n
	help
          This enables kernel support for NI driver tx offloading WNIC deamsdu function.
          If you would like to have WNIC do not deamsdu and pass to NIC tx, say 'Y'.

config RTK_WNIC_HWLOOKUP_SNAP_TRANSFORM_BY_HW
	bool "RTK WNIC HWLOOKUP snap transform by hw"
	depends on RTK_WNIC_HWLOOKUP_DEAMSDU_OFFLOAD
	default n
	help
	  This enables kernel support for NI driver tx offloading WNIC snap packets.
	  If you would like to have NIC tx without transform from SNAP, say 'Y'.
```

## rtl8198/linux-4.4.x/arch/mips/bsp_rtl9607c/Kconfig.hook
```kconfig
#
# Realtek Semiconductor Corp.
#
# Luna Platform Kernel Configuration
# MIPS_IA

if RTK_SOC_RTL8198D || RTK_SOC_RTL9607C
menu "Luna Platform Configuration"

if NONE_IMP
config LUNA_CMU
	depends on !ARCH_LUNA_SLAVE
	bool "Luna platform clock mangement module"
	default n
	help
		Enable/Disable clock management dynamic mode by Kernel.
		When this moduel is built, clock management dynamic mode
		will be turned off at the entry of RLX trap handler and
		turned on at the entry of cpu_idle().

config CPU0_FREQ_DIV_INDEX
	int "CPU0 frequency dividing factor at dynamic mode on (1:(1/2)F, 2:(1/4)..)"
	depends on LUNA_CMU
	range 1 7
	default 1
	help
		1:(1/2)F, 2:(1/4), 3:(1/8), 4:(1/16), 5:(1/32), 6:(1/64), 7:(1/128)

config CPU0_DLY_SLP_INDEX
	int "CPU0 frequency dividing activation delay (0: 0.5us, 1:1us, ...)"
	depends on LUNA_CMU
	range 0 7
	default 0
	help
		0:0.5us, 1:1us, 2:2us, 3:4us, 4:8us, 5:16us, 6:32us, 7:No Sleep
endif

config LUNA_WDT_KTHREAD
	depends on !ARCH_LUNA_SLAVE
	bool "Luna platform watchdog with watchdog kthread for kick"
	default n
	help
		Control (enable/disable) watchdog.
		Configure time-out and etc setting for watchdog

config WDT_ENABLE
	int "Enable or disalble WDT Kick at boot-up/RC34"
	depends on LUNA_WDT_KTHREAD
	range 0 2
	default 2
	help
                0:disable, 1:enable(Kicking begin on bootup), 2: Kicking begin on RC34

config WDT_CLK_SC
	int "WDT overflow scale"
	depends on LUNA_WDT_KTHREAD
	range 0 3
	default 3
	help
		0:2^25, 1:2^26, 2:2^27, 3:2^28

config WDT_PH1_TO
	int "WDT phase 1 time-out threshold"
	depends on LUNA_WDT_KTHREAD
	range 0 31
	default 31


config WDT_PH2_TO
	int "WDT phase 2 time-out threshold"
	depends on LUNA_WDT_KTHREAD
	range 0 31
	default 0
	help
		In the WDT ISR, related system information for further debugging should be collected within PH2.

config WDT_RESET_MODE
	int "WDT reset mode after PH2 time-out expires."
	depends on LUNA_WDT_KTHREAD
	range 0 2
	default 0
	help
		0:H/W Full Chip Reset,
		1:H/W CPU & IPSec Reset
		2:S/W Reset

config LUNA_RESERVE_DRAM_FOR_PBO
	bool "Luna platform reserve DRAM for PBO"
	depends on !ARCH_LUNA_SLAVE
	default n
	help
		Enable/Disable DRAM reservation for PBO

config LUNA_PBO_DL_DRAM_OFFSET
	hex "Luna platform PBO DL DRAM OFFSET(INVALID with Luna memory auto distribution)"
	depends on LUNA_RESERVE_DRAM_FOR_PBO
	default 0x1700000
	help
		The offset of DRAM to be reserved for PBO DL.

config LUNA_PBO_DL_DRAM_SIZE
	hex "Luna platform PBO DL DRAM SIZE"
	depends on LUNA_RESERVE_DRAM_FOR_PBO
	default 0x100000
	help
		The size of DRAM to be reserved for PBO DL.

config LUNA_PBO_UL_DRAM_OFFSET
	hex "Luna platform PBO UL DRAM OFFSET(INVALID with Luna memory auto distribution)"
	depends on LUNA_RESERVE_DRAM_FOR_PBO
	default 0x1F00000
	help
		The offset of DRAM to be reserved for PBO UL.

config LUNA_PBO_UL_DRAM_SIZE
	hex "Luna platform PBO UL DRAM SIZE"
	depends on LUNA_RESERVE_DRAM_FOR_PBO
	default 0x100000
	help
		The size of DRAM to be reserved for PBO UL.


if NONE_IMP
config LUNA_USE_SRAM
	bool "Luna platform 32KB SRAM mapping"
	depends on !ARCH_LUNA_SLAVE
	default n
	help
		Enable/Disable the 32KB SRAM Mapping automatically.
		The function will map 32KB space for __sram address of vmlinux.lds from DRAM onto SRAM
		to improve the performance.

config LUNA_USE_SRAM_ADDR
	hex "Luna platform 32KB SRAM mapping address(0 => Address of __sram section)"
	depends on LUNA_USE_SRAM
	default 0x0
	help
		The start address of sram mapping. 0x0 indicates that the platform will map the __section section
		from DRAM to SRAM with 32KB memory space. The assigned address would be used instead of __sram address.

endif

config SDK_FPGA_PLATFORM
	bool "Luna FPGA platform"
	default n
	help
		For FPGA board.
		LX: 30MHz


config YUEME_DMIPS_FEATURE
	depends on !ARCH_LUNA_SLAVE && YUEME
	bool "YUEME_DMIPS_FEATURE"
	default n

config YUEME_TMPFS_FEATURE
        depends on !ARCH_LUNA_SLAVE && YUEME
        bool "YUEME_TMPFS_FEATURE"
        default n
        help
             Limit file size on under /tmp directory!(tmpfs)

config YUEME_TMPFS_SIZE_FEATURE
        depends on !ARCH_LUNA_SLAVE && YUEME && TMPFS
        int "YUEME_TMPFS_SIZE_FEATURE"
        default 16
        help
		By default, /tmp and /var is limited to 16MB.
		If YUEME_TMPFS_SIZE_FEATURE=0, the system will to 40% of MemTotal.

config YUEME_APP_FORK_LIMIT_FEATURE
        depends on !ARCH_LUNA_SLAVE && YUEME && CGROUP_SCHED
        bool "YUEME App Framework Fork Limit FEATURE"
        default n
        help
             Limit the fork number of appframework!

config YUEME_APP_FORK_LIMIT_NUM
	int "YUEME_APP_FORK_LIMIT_NUM"
	depends on YUEME_APP_FORK_LIMIT_FEATURE && YUEME && CGROUP_SCHED
	default 100
	help
		Appframework'app can't fork over this value.

config YUEME_APP_THREAD_LIMIT_NUM
	int "YUEME_APP_THREAD_LIMIT_NUM"
	depends on YUEME_APP_FORK_LIMIT_FEATURE
	default 300
	help
		Appframework'app can't create thread over this value.

config YUEME_APP_FORK_LIMIT_KILLER
	bool "YUEME Appframework Limit Killer"
	depends on YUEME_APP_FORK_LIMIT_FEATURE
        default n
        help
             Every 120(s), Kthread(appf_m) will try to kill the process
             which forked over YUEME_APP_FORK_LIMIT_NUM.

config YUEME_FS_CHECK_FEATURE
	bool "YUEME App Framework FS Write Check"
	depends on YAFFS_FS	&& YUEME && CGROUP_SCHED
        default n
        help
             Avoid the application of AppFramework write fully the FS(YAFFS_FS) for Flash Partition.

config YUEME_FS_LIMIT_PERCENTAGE
	int "YUEME App Framework FS Write Allow Percentage"
	depends on YUEME_FS_CHECK_FEATURE
	range 0 100
        default 90
        help
             This option will inhibit the write operation into YAFFS_FS when FS's usage is higher than threshold.
             the FS is higher than CONFIG_YUEME_FS_LIMIT_PERCENTAGE%, the system doesn't allow this write operation.
             The system will try to kill this process.

endmenu
endif
```

## rtl8198/linux-4.4.x/arch/mips/saturn/Kconfig
```kconfig
config ARCH_CORTINA
	bool 
	depends on RTK_MIPS

choice
	prompt "Cortina machine Type"
	depends on RTK_MIPS
	default ARCH_CORTINA_SATURN_SFU
	help
	  Choose the Saturn sfu arch type
	  
config ARCH_CORTINA_SATURN_SFU
	bool "Saturn SFU"
	select CPU_RLX5281
	select SYS_HAS_CPU_RLX
	select GENERIC_IRQ_CHIP
	select SYS_SUPPORTS_LITTLE_ENDIAN
	select DMA_NONCOHERENT
	select HAS_DMA
	select USE_OF 
	select COMMON_CLK
	select DTC
	select ARCH_CORTINA
	select ARCH_WANT_OPTIONAL_GPIOLIB
	select PINCTRL
	select PINCTRL_CORTINA
	help
	  This enables support for Cortina Access Saturn Family of SoCs.

config ARCH_CORTINA_SATURN_SFP_PLUS
	bool "Saturn SFP+"
        depends on ARCH_CORTINA_SATURN_SFU
	help
	  This enables support for Cortina Access Saturn Family of SoCs.

endchoice

choice
	prompt "Board Type"
	depends on ARCH_CORTINA_SATURN_SFU
	default CORTINA_BOARD_FPGA
	help
	  Choose the Saturn sfu board type
	  
config CORTINA_BOARD_FPGA
	bool "FPGA Board"
	help
	  Cortina FPGA Board
	  
config CORTINA_BOARD_SATURN_SFU_ENG
	bool "Saturn SFU Engineering Board"
	help
	  Cortina Saturn SFU Engineering Board
  
config CORTINA_BOARD_SATURN_SFP_PLUS_ENG
	bool "Saturn SFP+ Engineering Board"
        depends on ARCH_CORTINA_SATURN_SFP_PLUS
	help
	  Cortina Saturn SFP+ Engineering Board

config CORTINA_BOARD_SATURN_SFU_TITAN
	bool "Titan FPGA Board"
	help
	  Cortina Titan FPGA Board

endchoice
```

## rtl8198/linux-4.4.x/drivers/clk/realtek/Kconfig
```kconfig
config COMMON_CLK_RTK_APRO
	bool "RTK ApolloPro Clock Driver"
	depends on (CLKSRC_MIPS_GIC)
	help
	  Build the RTK ApolloPro clock driver based on the common clock framework.
```

## rtl8198/linux-4.4.x/drivers/mtd/spi-nand/Kconfig
```kconfig
menuconfig MTD_SPI_NAND
	tristate "SPI-NAND device Support"
	depends on MTD_NAND_BBT
	help
	  This is the framework for the SPI NAND which can be used by both generic
	  SPI bus and SPI-NAND specified controllers.

if MTD_SPI_NAND

config SPI_NAND_USE_SPI_NOR_RD_PROT
	bool "Use SPI NOR flash 03h/0bh read protocol"
	default n
	help
	  Micron M79A SPI NAND support implement 03h/0Bh command, as is done
	  with SPI NOR for compatibility.

config MTD_SPI_NAND_VENUS
        bool "Support for Venus SPI-NAND deviece"
        default n
        help
          This is the updated framework for supporting Venus SPI-NAND INIT flow. 

config NAND_HIDE_BAD
    tristate "NAND Flash factory bad block hidden mechanism"
    depends on ARCH_CORTINA && MTD_SPI_NAND
    help
      This configuration is used for the factory bad block hidden mechanism

endif # MTD_SPI_NAND

source "drivers/mtd/spi-nand/chips/Kconfig"
```

## rtl8198/linux-4.4.x/drivers/mtd/spi-nand/chips/Kconfig
```kconfig
menu "SPI NAND controller drivers"
	depends on MTD_SPI_NAND

config GENERIC_SPI_NAND
	tristate "SPI-NAND with generic SPI bus Support"
	depends on SPI
	help
	  This is to support SPI NAND device with generic SPI bus.

config CORTINA_SPI_NAND
    tristate "SPI NAND with Cortina SPI-NAND Controller"
    help
      This is to support SPI NAND device with Cortina SPI-NAND Controller.


config CORTINA_SPI_NAND_VENUS
    tristate "Venus SPI NAND driver with Cortina SPI-NAND Controller"
    help
      This is to support Venus SPI NAND device with Cortina SPI-NAND Controller.

endmenu
```

## rtl8198/linux-4.4.x/drivers/net/ethernet/atlantic/Kconfig
```kconfig
#
# aQuantia device configuration
#

config NET_VENDOR_ATLANTIC
	tristate "aQuantia AQtion(tm) Support"
	depends on PCI
	default n
	---help---
	  This enables the support for the aQuantia AQtion(tm) Ethernet card.
```
